## drivers/video/fbdev/msm/panel_driver/Kconfig
```kconfig
config FB_MSM_MDSS_SPECIFIC_PANEL
	depends on FB_MSM_MDSS
	bool
	prompt "Sony MDSS Specific Panel Diver"
	default n
	---help---
	  Sony MDSS Specific Panel Driver provides support for specific
	  Sony Xperia display panels.

config FB_MSM_MDSS_SPECIFIC_PANEL_INCELL
	depends on FB_MSM_MDSS_SPECIFIC_PANEL
	select REGULATOR_QPNP_LABIBB_SOMC
	bool
	prompt "Sony Xperia In-Cell Panel Driver"
	default n
	---help---
	  Sony Xperia In-Cell Panel Driver support.

config FB_MSM_MDSS_EARLY_UNBLANK
	depends on FB_MSM_MDSS_SPECIFIC_PANEL_INCELL
	bool
	prompt "Sony Early Unblank feature for quick display wakeup"
	default y
	---help---
	  Sony Early Unblank feature for quick display wakeup.
```

## techpack/audio/asoc/Kconfig
```kconfig
menu "ALSA based drivers"

config SND_SOC_MACHINE_MSM8998
	bool "SoC Machine Driver for MSM8998 Boards"
	help
	  To add support for SoC audio on MSM8998.

config SND_SOC_SDM670
	bool "SoC Machine Driver for SDM670 Boards"
	help
	  To add support for SoC audio on SDM670.

config SND_SOC_INT_CODEC
	bool "SND_SOC_INT_CODEC"

config SND_SOC_EXT_CODEC
	bool "SND_SOC_EXT_CODEC"

config SND_SOC_MACHINE_SDM845
	bool "SoC Machine Driver for SDM845 Boards"
	help
	  To add support for SoC audio on SDM845.

config SND_SOC_MACHINE_SDXPOORWILLS
	bool "SoC Machine Driver for SDXPOORWILLS Boards"
	help
	  To add support for SoC audio on SDXPOORWILLS.

config SND_SOC_EXT_CODEC_8909
	bool "SoC Machine Driver for MSM8909 External Codec"
	help
	  To add support for SoC Machine Driver for
	  MSM8909 External Codec.

config SND_SOC_SDM450
	bool "SoC Machine Driver for SDM450 Boards"
	help
	  To add support for SoC audio on SDM450.

config SND_SOC_EXT_CODEC_SDM450
	bool "SoC Machine Driver for SDM450 External Codec"
	help
	  To add support for SoC Machine Driver for
	  SDM450 External Codec.

config SND_SOC_MSM8909
	bool "SoC Machine Driver for MSM8909 Boards"
	help
	  To add support for SoC audio on MSM8909.

config SND_SOC_8909_DIG_CDC
	bool "SoC Machine Driver for MSM8909 Digital Codec"
	help
	  To add support for SoC Machine Driver for
	  MSM8909 Digital Codec.

config SND_SOC_MSM8952
	bool "SoC Machine Driver for MSM8952 Boards"
	help
	  To add support for SoC audio on MSM8952.

config SND_SOC_CPE
	bool "CPE LSM platform driver"
	help
	  To add support for Codec Processing Engine. This support
	  is to enable CPE block on the codec and this config needs
	  to be added to codecs that contain the CPE hardware block.
	  The configuration includes the cpe lsm driver to enable
	  listen on codec.

config SND_SOC_QDSP6V2
	bool "SoC ALSA audio driver for QDSP6V2"
	help
	  To add support for MSM QDSP6V2 Soc Audio.
	  This will enable sound soc platform specific
	  audio drivers. This includes q6asm, q6adm,
	  q6afe interfaces to DSP using apr.

config SND_SOC_MSM_HOSTLESS_PCM
	bool "SND_SOC_MSM_HOSTLESS_PCM"

config SND_HWDEP_ROUTING
	bool "SND_HWDEP_ROUTING"

config DOLBY_DS2
	bool "Dolby DS2"
	help
	  To add support for dolby DAP post processing.
	  This support is to configure the post processing parameters
	  to DSP. The configuration includes sending the end point
	  device, end point dependent post processing parameters and
	  the various posrt processing parameters.

config DOLBY_LICENSE
	bool "Dolby LICENSE"
	help
	  To add support for dolby DAP post processing,
	  and retain DAP set license functionality only.
	  This is required by Dolby GEF implementation which needs
	  nothing but dolby license validation functionality in driver.

config QTI_PP
	bool "QTI PP"
	help
	  To add support for default QTI post processing.
	  This support is to configure the post processing
	  parameters to DSP. The configuration includes sending
	  tuning parameters of various modules such as equalizer,
	  customized mixing.

source "techpack/audio/asoc/codecs/Kconfig"

endmenu
```

## techpack/audio/asoc/codecs/Kconfig
```kconfig
menu "Codec drivers"

config WCD9XXX_CODEC_CORE
	bool "WCD9XXX Codec Core Driver"

config SND_SOC_WCD9XXX_V2
	bool "WCD9XXX v2 Codec Core Driver"

config SND_SOC_WCD9335
	bool "WCD9335 Tasha Codec Driver"

config SND_SOC_WCD_CPE
	bool "WCD CPE Core"

config SND_SOC_WCD_MBHC
	bool "WCD MBHC V2 Module"

config SND_SOC_WCD_MBHC_ADC
	bool "WCD MBHC ADC"

config SND_SOC_WCD_MBHC_LEGACY
	bool "WCD MBHC Legacy"

config SND_SOC_WSA881X
	bool "WSA881x Codec Driver"

config SND_SOC_WSA881X_ANALOG
	bool "WSA881x Analog Codec Driver"

config SND_SOC_WCD_SPI
	bool "WCD SPI driver"

config SND_SOC_MSM_STUB
	bool "Generic MSM Codec Driver"

config SND_SOC_MSM_HDMI_CODEC_RX
	bool "MSM External Display Audio Codec Driver"

config AUDIO_EXT_CLK
	bool "Audio Ref (Up) Clock Module Platform Driver"

source "techpack/audio/asoc/codecs/msm_bg/Kconfig"

source "techpack/audio/asoc/codecs/msm_sdw/Kconfig"

source "techpack/audio/asoc/codecs/sdm660_cdc/Kconfig"

source "techpack/audio/asoc/codecs/wcd934x/Kconfig"

endmenu
```

## techpack/audio/asoc/codecs/msm_bg/Kconfig
```kconfig
menu "BG Codec driver"

config SND_SOC_BG_CODEC
	bool "BG Codec driver"

endmenu
```

## techpack/audio/asoc/codecs/msm_sdw/Kconfig
```kconfig
menu "MSM Internal soundwire codec"

config SND_SOC_MSM_SDW
	bool "MSM Internal soundwire codec"
	help
	  MSM-based soundwire codec core driver
	  supported along with internal digital
	  codec core.

endmenu
```

## techpack/audio/asoc/codecs/sdm660_cdc/Kconfig
```kconfig
menu "SDM660 MSM Audio Codec Driver"

config SND_SOC_ANALOG_CDC
	bool "MSM Audio Analog codec driver"

config SND_SOC_DIGITAL_CDC
	bool "MSM Audio Digital codec driver"

config SND_SOC_DIGITAL_CDC_LEGACY
	bool "MSM Audio Digital codec driver legacy"

endmenu
```

## techpack/audio/asoc/codecs/wcd934x/Kconfig
```kconfig
menu "WCD934X Tavil Codec Driver"

config SND_SOC_WCD934X
	bool "WCD934X Tavil Codec driver"

endmenu
```

## techpack/audio/dsp/Kconfig
```kconfig
menu "DSP low level drivers/Audio ION/ADSP Loader"

config SND_SOC_MSM_QDSP6V2_INTF
	bool "SoC Q6 audio driver"
	help
	  This will enable all the platform specific
	  interactions towards DSP. It includes asm,
	  adm and afe interfaces on the DSP.

config MSM_ADSP_LOADER
	bool "ADSP loader support"
	help
	  Enable ADSP image loader.
	  The ADSP loader brings ADSP out of reset
	  for the platforms that use APRv2.

config MSM_QDSP6_PDR
	bool "PDR framework driver"

config MSM_QDSP6_SSR
	bool "SSR framework driver"

config MSM_QDSP6_NOTIFIER
	bool "Audio notifier driver"

config MSM_ULTRASOUND
	bool "QDSP6V2 HW Ultrasound support"
	help
	  Enable HW Ultrasound support in QDSP6V2.
	  QDSP6V2 can support HW encoder & decoder and
	  ultrasound processing. It will enable
	  ultrasound data paths between
	  HW and services, calculating input events
	  upon the ultrasound data.

config MSM_AVTIMER
	bool "Avtimer Driver"
	help
	  This driver gets the Q6 out of power collapsed state
	  and exposes ioctl control to read avtimer tick.
	  Enables camera to use for VT call to get avtimer
	  timestamp.

config DTS_SRS_TM
	bool "Enable DTS SRS"
	help
	 To add support for DTS SRS post processing.
	 This support is to configure the post processing
	 parameters to DSP. The configuration includes sending
	 tuning parameters of various modules.

source "techpack/audio/dsp/codecs/Kconfig"

endmenu
```

## techpack/audio/dsp/codecs/Kconfig
```kconfig
menu "Native encoders and decoders"

config MSM_QDSP6V2_CODECS
	bool "Audio QDSP6V2 APR support"
	help
	  Enable Audio codecs with APR IPC protocol support between
	  application processor and QDSP6 for B-family. APR is
	  used by audio driver to configure QDSP6's
	  ASM, ADM and AFE.

endmenu
```

## techpack/audio/ipc/Kconfig
```kconfig
menu "APR IPC communication drivers"

config MSM_QDSP6_APRV2
	bool "Audio QDSP6 APRv2 support"
	help
	  Enable APRv2 IPC protocol support between
	  application processor and QDSP6. APR is
	  used by audio driver to configure QDSP6's
	  ASM, ADM and AFE.

config MSM_QDSP6_APRV3
	bool "Audio QDSP6 APRv3 support"
	help
	  Enable APRv3 IPC protocol support between
	  application processor and QDSP6. APR is
	  used by audio driver to configure QDSP6v2's
	  ASM, ADM and AFE.

config MSM_QDSP6_APRV2_GLINK
	bool "Audio QDSP6 APRv2 over Glink support"
	help
	  Enable APRv2 IPC protocol support over
	  Glink between application processor and
	  QDSP6. APR is used by audio driver to
	  configure QDSP6's ASM, ADM and AFE.

config MSM_QDSP6_APRV3_GLINK
	bool "Audio QDSP6 APRv3 over Glink support"
	help
	  Enable APRv3 IPC protocol support over
	  Glink between application processor and
	  QDSP6. APR is used by audio driver to
	  configure QDSP6v2's ASM, ADM and AFE.

config MSM_BG_GLINK
	bool "WCD DSP GLINK Driver"
	help
	  This option enables driver which provides communication interface
	  between MSM and BG over glink transport protocol. This driver
	  provides read and write interface via char device.This driver is
	  used by the audio codec driver to interface with BG.

config WCD_DSP_GLINK
	bool "WCD DSP GLINK Driver"
	help
	  This option enables driver which provides communication interface
	  between MSM and WCD DSP over glink transport protocol. This driver
	  provides read and write interface via char device.

endmenu
```

## techpack/audio/soc/Kconfig
```kconfig
menu "SoC based drivers (pinctrl/regmap/soundwire)"

config PINCTRL_WCD
	bool "WCD GPIO pin control driver"

config PINCTRL_LPI
	bool "LPI GPIO pin control driver"

config SOUNDWIRE
	bool "Soundwire module"

config SOUNDWIRE_WCD_CTRL
	bool "WCD SoundWire Controller"

endmenu
```
