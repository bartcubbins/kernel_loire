## Documentation/devicetree/bindings/clock/qcom,msm8976-cpucc.txt
```
Qualcomm Technologies, Inc. MSM8976 CPU clock driver
---------------------------------------------------

It is the clock controller driver which provides higher frequency
clocks and allows CPU frequency scaling on msm8956/76 based platforms.

Required properties:
- compatible:		Shall contain following:
			"qcom,cpu-msm8976"

- reg:			Shall contain base register offset and size.
- reg-names:		Names of the bases for the above registers. Expected
			bases are:
			"rcgwr-c0-base" (optional), "rcgwr-c1-base" (optional),
			"c0-pll", "c1-pll", "cci-pll",
			"c0-mux", "c1-mux", "cci-mux",
			"efuse", "spm_c0_base",
			"spm_c1_base", "spm_cci_base".

- clocks:		The clocks sources used by the cluster/cci mux.
- clock-names:		Names of the used clocks. Shall contain following:
			"xo_a", "aux_clk_2", "aux_clk_3".

- vdd_mx-supply:	The regulator powering all the PLLs of cluster-0,
			cluster-1, cci.
- vdd_a72-supply:	The regulator powering the big cluster
- vdd_a53-supply:	The regulator powering the little cluster
- vdd_cci-supply:	The regulator powering the CCI cluster

- qcom,speedX-bin-vY-ZZZ:
			A table of CPU frequency (Hz) to voltage (corner)
			mapping that represents the max frequency possible
			for each supported voltage level for a CPU. 'X' is
			the speed bin into which the device falls into - a
			bin will have unique frequency-voltage relationships.
			'Y' is the characterization version, implying that
			characterization (deciding what speed bin a device
			falls into) methods and/or encoding may change. The
			values 'X' and 'Y' are read from efuse registers, and
			the right table is picked from multiple possible tables.
			'ZZZ' can be c1, c0 or cci depending on whether the table
			is for the big cluster, little cluster or cci.

- #clock-cells:		Shall contain 1.

Optional properties:
- qcom,num-clusters:	Number of clusters which support RCGwR.
- qcom,lmh-sid-cX:	List of LMH SID offset and value to be programmed for
			each cluster (X: 0 or 1)
- qcom,link-sid-cX:	List of Link SID offset and value to be programmed for
			each cluster (X: 0 or 1)
- qcom,dfs-sid-cX:	List of DFS SID offset and value to be programmed for
			each cluster (X: 0 or 1)
- qcom,ramp-dis-cX:	Boolean property to disable ramp down for each cluster
			(X: 0 or 1)

Example:
	clock_cpu: cpu-clock-controller@b016000 {
		compatible = "qcom,cpu-msm8976";

		reg =   <0xb114000  0x68>,
			<0xb014000  0x68>,
			<0xb116000  0x40>,
			<0xb016000  0x40>,
			<0xb1d0000  0x40>,
			<0xb111050  0x08>,
			<0xb011050  0x08>,
			<0xb1d1050  0x08>,
			<0x00a412c  0x08>,
			<0xb111200 0x100>,
		        <0xb011200 0x100>,
			<0xb1d4000 0x100>;
		reg-names = "rcgwr-c0-base", "rcgwr-c1-base",
			    "c0-pll", "c1-pll", "cci-pll",
			    "c0-mux", "c1-mux", "cci-mux",
			    "efuse", "spm_c0_base",
			    "spm_c1_base", "spm_cci_base";

		/* RCGwR settings */
		qcom,num-clusters = <2>;
		qcom,lmh-sid-c0  = < 0x30 0x077706db>,
				   < 0x34 0x05550249>,
				   < 0x38 0x00000111>;
		qcom,link-sid-c0 = < 0x40 0x000fc987>;
		qcom,dfs-sid-c0  = < 0x10 0xfefebff7>,
				   < 0x14 0xfdff7fef>,
				   < 0x18 0xfbffdefb>,
				   < 0x1c 0xb69b5555>,
				   < 0x20 0x24929249>,
				   < 0x24 0x49241112>,
				   < 0x28 0x11112111>,
				   < 0x2c 0x00008102>;
		qcom,lmh-sid-c1  = < 0x30 0x077706db>,
				   < 0x34 0x05550249>,
				   < 0x38 0x00000111>;
		qcom,link-sid-c1 = < 0x40 0x000fc987>;
		qcom,dfs-sid-c1  = < 0x10 0xfefebff7>,
				   < 0x14 0xfdff7fef>,
				   < 0x18 0xfbffdefb>,
				   < 0x1c 0xb69b5555>,
				   < 0x20 0x24929249>,
				   < 0x24 0x49241112>,
				   < 0x28 0x11112111>,
				   < 0x2c 0x00008102>;

		vdd_mx_hf-supply = <&pm8950_s6_level_ao>;
		vdd_hf_pll-supply = <&pm8950_l7_ao>;
		vdd_mx_sr-supply = <&pm8950_s6_level_ao>;
		vdd_a72-supply = <&apc1_vreg_corner>;
		vdd_a53-supply = <&apc0_vreg_corner>;
		vdd_cci-supply = <&apc0_vreg_corner>;

		clocks = <&clock_rpmcc RPM_XO_A_CLK_SRC>,
			 <&clock_gcc GPLL4_OUT_MAIN>,
			 <&clock_gcc GPLL0_AO_OUT_MAIN>;
		clock-names = "xo_a", "aux_clk_2", "aux_clk_3";

		qcom,speed0-bin-v0-c0 =
			<          0 0>,
			<  400000000 1>,
			<  691200000 2>,
			<  806400000 3>,
			< 1017600000 4>,
			< 1190400000 5>,
			< 1305600000 6>,
			< 1382400000 7>,
			< 1401600000 8>;
		qcom,speed0-bin-v0-c1 =
			<          0 0>,
			<  400000000 1>,
			<  883200000 2>,
			< 1190400000 3>,
			< 1382400000 4>,
			< 1612800000 5>,
			< 1747200000 6>,
			< 1804800000 7>;
		qcom,speed0-bin-v0-cci =
			<          0 0>,
			<  307200000 1>,
			<  403200000 3>,
			<  441600000 4>,
			<  556800000 5>,
			<  614400000 6>;
		#clock-cells = <1>;
	};
```

## Documentation/devicetree/bindings/pinctrl/qcom,msm8976-pinctrl.txt
```
Qualcomm MSM8976 TLMM block

This binding describes the Top Level Mode Multiplexer block found in the
MSM8976/56 platforms.

- compatible:
	Usage: required
	Value type: <string>
	Definition: must be "qcom,msm8976-pinctrl"

- reg:
	Usage: required
	Value type: <prop-encoded-array>
	Definition: the base address and size of the TLMM register space.

- interrupts:
	Usage: required
	Value type: <prop-encoded-array>
	Definition: should specify the TLMM summary IRQ.

- interrupt-controller:
	Usage: required
	Value type: <none>
	Definition: identifies this node as an interrupt controller

- #interrupt-cells:
	Usage: required
	Value type: <u32>
	Definition: must be 2. Specifying the pin number and flags, as defined
		    in <dt-bindings/interrupt-controller/irq.h>

- gpio-controller:
	Usage: required
	Value type: <none>
	Definition: identifies this node as a gpio controller

- #gpio-cells:
	Usage: required
	Value type: <u32>
	Definition: must be 2. Specifying the pin number and flags, as defined
		    in <dt-bindings/gpio/gpio.h>

- gpio-ranges:
	Usage: required
	Definition:  see ../gpio/gpio.txt

- gpio-reserved-ranges:
	Usage: optional
	Definition: see ../gpio/gpio.txt

Please refer to ../gpio/gpio.txt and ../interrupt-controller/interrupts.txt for
a general description of GPIO and interrupt bindings.

Please refer to pinctrl-bindings.txt in this directory for details of the
common pinctrl bindings used by client devices, including the meaning of the
phrase "pin configuration node".

The pin configuration nodes act as a container for an arbitrary number of
subnodes. Each of these subnodes represents some desired configuration for a
pin, a group, or a list of pins or groups. This configuration can include the
mux function to select on those pin(s)/group(s), and various pin configuration
parameters, such as pull-up, drive strength, etc.


PIN CONFIGURATION NODES:

The name of each subnode is not important; all subnodes should be enumerated
and processed purely based on their content.

Each subnode only affects those parameters that are explicitly listed. In
other words, a subnode that lists a mux function but no pin configuration
parameters implies no information about any pin configuration parameters.
Similarly, a pin subnode that describes a pullup parameter implies no
information about e.g. the mux function.


The following generic properties as defined in pinctrl-bindings.txt are valid
to specify in a pin configuration subnode:

- pins:
	Usage: required
	Value type: <string-array>
	Definition: List of gpio pins affected by the properties specified in
		    this subnode. Valid pins are:
		      gpio0-gpio144
		      sdc1_clk,
		      sdc1_cmd,
		      sdc1_data,
		      sdc1_rclk,
		      sdc2_clk,
		      sdc2_cmd,
		      sdc2_data,
		      qdsd_clk,
		      qdsd_cmd,
		      qdsd_data0,
		      qdsd_data1,
		      qdsd_data2,
		      qdsd_data3

- function:
	Usage: required
	Value type: <string>
	Definition: Specify the alternative function to be configured for the
		    specified pins. Functions are only valid for gpio pins.
		    Valid values are:

		    blsp_i2c1, blsp_i2c2, blsp_i2c3, blsp_i2c4, blsp_i2c5,
			blsp_i2c6, blsp_i2c8, blsp_spi1, blsp_spi2, blsp_spi3,
			blsp_spi4, blsp_spi5, blsp_spi6, blsp_spi8, blsp1_spi,
			blsp3_spi, blsp_uart1, blsp_uart2, blsp_uart5, blsp_uart6,
			cap_int, cam_mclk, cdc_pdm0, cci0_i2c, cci1_i2c,
			codec_int1, codec_int2, codec_reset, dmic0_clk, dmic0_data,
			gcc_gp1_clk_a, gcc_gp1_clk_b, gcc_gp2_clk_a, gcc_gp2_clk_b, gcc_gp3_clk_a,
			gcc_gp3_clk_b, gsm0_tx, gsm1_tx, gpio, hdmi_int,
			key_focus, key_home, key_snapshot, key_volp, lpass_slimbus,
			lpass_slimbus0, lpass_slimbus1, mdp_vsync, mipi_dsi0, modem_tsync,
			m_voc, pa_indicator, pri_mi2s, pri_mi2s_mclk_a, pri_mi2s_mclk_b,
			pri_mi2s_mclk_c, pwr_down, qdss_traceclk_a, qdss_traceclk_b, qdss_tracedata_a,
			qdss_tracedata_b, qdss_tracectl_a, qdss_tracectl_b, sdcard_det, sd_write,
			sdc3, sec_mi2s, sec_mi2s_mclk_a, sec_mi2s_mclk_b, smb_int,
			ss_switch, ssbi_wtr1, ts_resout, ts_sample, ts_xvdd,
			uim_batt, uim1_clk, uim1_data, uim1_present, uim1_reset,
			uim2_clk, uim2_data, uim2_present, uim2_reset, us_emitter,
			us_euro, wcss_bt, wcss_fm, wcss_wlan, wcss_wlan0,
			wcss_wlan1, wcss_wlan2, wsa_en, wsa_irq, wsa_vi

- bias-disable:
	Usage: optional
	Value type: <none>
	Definition: The specified pins should be configued as no pull.

- bias-pull-down:
	Usage: optional
	Value type: <none>
	Definition: The specified pins should be configued as pull down.

- bias-pull-up:
	Usage: optional
	Value type: <none>
	Definition: The specified pins should be configued as pull up.

- output-high:
	Usage: optional
	Value type: <none>
	Definition: The specified pins are configured in output mode, driven
		    high.
		    Not valid for sdc pins.

- output-low:
	Usage: optional
	Value type: <none>
	Definition: The specified pins are configured in output mode, driven
		    low.
		    Not valid for sdc pins.

- drive-strength:
	Usage: optional
	Value type: <u32>
	Definition: Selects the drive strength for the specified pins, in mA.
		    Valid values are: 2, 4, 6, 8, 10, 12, 14 and 16

Example:

	tlmm: pinctrl@1000000 {
		compatible = "qcom,msm8976-pinctrl";
		reg = <0x1000000 0x300000>;
		interrupts = <0 208 0>;
		gpio-controller;
		#gpio-cells = <2>;
		gpio-ranges = <&tlmm 0 0 150>;
		interrupt-controller;
		#interrupt-cells = <2>;

		uart_console_active: uart_console_active {
			mux {
				pins = "gpio4", "gpio5", "gpio6", "gpio7";
				function = "blsp_uart2";
			};

			config {
				pins = "gpio4", "gpio5", "gpio6", "gpio7";
				drive-strength = <2>;
				bias-disable;
			};
		};
	};
```

## drivers/input/touchscreen/synaptics_dsx_td4322/Kconfig
```kconfig
#
# Synaptics DSX TD4322 touchscreen driver configuration
#
menuconfig TOUCHSCREEN_SYNAPTICS_DSX_TD4322
	bool "Synaptics DSX TD4322 touchscreen"
	default n
	help
	  Say Y here if you have a Synaptics DSX TD4322 touchscreen connected
	  to your system.

	  If unsure, say N.

if TOUCHSCREEN_SYNAPTICS_DSX_TD4322

choice
	default TOUCHSCREEN_SYNAPTICS_DSX_TD4322_I2C
	prompt "Synaptics DSX TD4322 bus interface"
config TOUCHSCREEN_SYNAPTICS_DSX_TD4322_I2C
	bool "RMI over I2C"
	depends on I2C
config TOUCHSCREEN_SYNAPTICS_DSX_TD4322_SPI
	bool "RMI over SPI"
	depends on SPI_MASTER
config TOUCHSCREEN_SYNAPTICS_DSX_TD4322_RMI_HID_I2C
	bool "HID over I2C"
	depends on I2C
endchoice

config TOUCHSCREEN_SYNAPTICS_DSX_TD4322_CORE
	tristate "Synaptics DSX TD4322 core driver module"
	depends on I2C || SPI_MASTER
	help
	  Say Y here to enable basic touch reporting functionality.

	  If unsure, say N.

	  To compile this driver as a module, choose M here: the
	  module will be called synaptics_dsx_core.

config TOUCHSCREEN_SYNAPTICS_DSX_TD4322_RMI_DEV
	tristate "Synaptics DSX TD4322 RMI device module"
	depends on TOUCHSCREEN_SYNAPTICS_DSX_TD4322_CORE
	help
	  Say Y here to enable support for direct RMI register access.

	  If unsure, say N.

	  To compile this driver as a module, choose M here: the
	  module will be called synaptics_dsx_rmi_dev.

config TOUCHSCREEN_SYNAPTICS_DSX_TD4322_FW_UPDATE
	tristate "Synaptics DSX TD4322 firmware update module"
	depends on TOUCHSCREEN_SYNAPTICS_DSX_TD4322_CORE
	help
	  Say Y here to enable support for doing firmware update.

	  If unsure, say N.

	  To compile this driver as a module, choose M here: the
	  module will be called synaptics_dsx_fw_update.

config TOUCHSCREEN_SYNAPTICS_DSX_TD4322_TEST_REPORTING
	tristate "Synaptics DSX TD4322 test reporting module"
	depends on TOUCHSCREEN_SYNAPTICS_DSX_TD4322_CORE
	help
	  Say Y here to enable support for retrieving production test reports.

	  If unsure, say N.

	  To compile this driver as a module, choose M here: the
	  module will be called synaptics_dsx_test_reporting.

config TOUCHSCREEN_SYNAPTICS_DSX_TD4322_PROXIMITY
	tristate "Synaptics DSX TD4322 proximity module"
	depends on TOUCHSCREEN_SYNAPTICS_DSX_TD4322_CORE
	help
	  Say Y here to enable support for proximity functionality.

	  If unsure, say N.

	  To compile this driver as a module, choose M here: the
	  module will be called synaptics_dsx_proximity.

config TOUCHSCREEN_SYNAPTICS_DSX_TD4322_ACTIVE_PEN
	tristate "Synaptics DSX TD4322 active pen module"
	depends on TOUCHSCREEN_SYNAPTICS_DSX_TD4322_CORE
	help
	  Say Y here to enable support for active pen functionality.

	  If unsure, say N.

	  To compile this driver as a module, choose M here: the
	  module will be called synaptics_dsx_active_pen.

config TOUCHSCREEN_SYNAPTICS_DSX_TD4322_GESTURE
	tristate "Synaptics DSX TD4322 user defined gesture module"
	depends on TOUCHSCREEN_SYNAPTICS_DSX_TD4322_CORE
	help
	  Say Y here to enable support for user defined gesture functionality.

	  If unsure, say N.

	  To compile this driver as a module, choose M here: the
	  module will be called synaptics_dsx_gesture.

config TOUCHSCREEN_SYNAPTICS_DSX_TD4322_VIDEO
	tristate "Synaptics DSX TD4322 video module"
	depends on TOUCHSCREEN_SYNAPTICS_DSX_CORE
	help
	  Say Y here to enable support for video communication functionality.

	  If unsure, say N.

	  To compile this driver as a module, choose M here: the
	  module will be called synaptics_dsx_video.

config TOUCHSCREEN_SYNAPTICS_DSX_TD4322_DEBUG
	tristate "Synaptics DSX TD4322 debug module"
	depends on TOUCHSCREEN_SYNAPTICS_DSX_TD4322_CORE
	help
	  Say Y here to enable support for firmware debug functionality.

	  If unsure, say N.

	  To compile this driver as a module, choose M here: the
	  module will be called synaptics_dsx_debug.

endif
```

## drivers/net/wireless/broadcom/Kconfig
```kconfig
config WLAN_VENDOR_BROADCOM
	bool "Broadcom devices"
	default y
	---help---
	  If you have a wireless card belonging to this class, say Y.

	  Note that the answer to this question doesn't directly affect the
	  kernel: saying N will just cause the configurator to skip all
	  the questions about  cards. If you say Y, you will be asked for
	  your specific card in the following questions.

if WLAN_VENDOR_BROADCOM

source "drivers/net/wireless/broadcom/b43/Kconfig"
source "drivers/net/wireless/broadcom/b43legacy/Kconfig"
source "drivers/net/wireless/broadcom/brcm80211/Kconfig"
source "drivers/net/wireless/broadcom/bcmdhd/Kconfig"

config BROADCOM_WIFI_RESERVED_MEM
	bool "BROADCOM Reserved memory for wifi device"
	depends on SOMC_WIFI_CONTROL
	default n
	---help---
	  This is a configuration for broadcom WLAN driver.

config SOMC_WIFI_CONTROL
	bool "Enable/disable SOMC WiFi control function"
	---help---
	  A SOMC adaptation for the WLAN driver module

endif # WLAN_VENDOR_BROADCOM
```
